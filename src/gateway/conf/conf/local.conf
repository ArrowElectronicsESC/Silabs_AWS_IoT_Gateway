## src/gateway/conf/conf/local.conf
```bitbake
#
# Machine Selection
#
# You need to select a specific machine to target the build with. There are a selection
# of emulated machines available which can boot and run in the QEMU emulator:
#
MACHINE ??= "dragonboard-410c"

# CONF_VERSION is increased each time build/conf/ changes incompatibly
CONF_VERSION = "1"

# Which files do we want to parse:
BBMASK = ""

# What kind of images do we want?
IMAGE_FSTYPES_append = " tar.xz"

# Don't generate the mirror tarball for SCM repos, the snapshot is enough
BB_GENERATE_MIRROR_TARBALLS = "0"

# Disable build time patch resolution. This would lauch a devshell
# and wait for manual intervention. We disable it.
PATCHRESOLVE = "noop"


#
# Package Management configuration
#
# This variable lists which packaging formats to enable. Multiple package backends
# can be enabled at once and the first item listed in the variable will be used
# to generate the root filesystems.
# Options are:
#  - 'package_deb' for debian style deb files
#  - 'package_ipk' for ipk files are used by opkg (a debian style embedded package manager)
#  - 'package_rpm' for rpm style packages
# E.g.: PACKAGE_CLASSES ?= "package_rpm package_deb package_ipk"
# We default to ipk:
PACKAGE_CLASSES ?= "package_rpm"

#
# Parallelism Options
#
# These two options control how much parallelism BitBake should use. The first
# option determines how many tasks bitbake should run in parallel:
# Default to setting automatically based on cpu count
#BB_NUMBER_THREADS ?= "${@oe.utils.cpu_count()}"
#
# The second option controls how many processes make should run in parallel when
# running compile tasks:
# Default to setting automatically based on cpu count
#PARALLEL_MAKE ?= "-j ${@oe.utils.cpu_count()}"

#
# Shared-state files from other locations
#
# Shared state files are prebuilt cache data objects which can
# used to accelerate build time. This variable can be used to configure the system
# to search other mirror locations for these objects before it builds the data itself.
#
# This can be a filesystem directory, or a remote url such as http or ftp. These
# would contain the sstate-cache results from previous builds (possibly from other
# machines). This variable works like fetcher MIRRORS/PREMIRRORS and points to the
# cache locations to check for the shared objects.
#SSTATE_MIRRORS ?= "\
#file://.* http://someserver.tld/share/sstate/ \n \
#file://.* file:///some/local/dir/sstate/"

# enable PR service on build machine itself
# its good for a case when this is the only builder
# generating the feeds
#PRSERV_HOST = "localhost:0"


EXTRA_IMAGE_FEATURES = "debug-tweaks"

USER_CLASSES ?= "buildstats image-mklibs image-prelink"

DISTRO ?= "rpb"

DISTRO_FEATURES_append = " bluez5 ppp"

SERIAL_CONSOLES ?= "115200;ttyMSM0 115200;ttyGS0"

GCCVERSION = "arm-8.%"

BB_NUMBER_THREADS = "4"
PARALLEL_MAKE = "-j 4"

# Possible provider: cacao-initial-native and jamvm-initial-native
PREFERRED_PROVIDER_virtual/java-initial-native = "cacao-initial-native"

# Possible provider: cacao-native and jamvm-native
PREFERRED_PROVIDER_virtual/java-native = "jamvm-native"

# Optional since there is only one provider for now
PREFERRED_PROVIDER_virtual/javac-native = "ecj-bootstrap-native"
```

## src/gateway/layers/meta-backports/conf/layer.conf
```bitbake
# We have a conf and classes directory, add to BBPATH
BBPATH .= ":${LAYERDIR}"

BBFILE_COLLECTIONS += "backports"
BBFILE_PATTERN_backports := "^${LAYERDIR}/"
BBFILE_PRIORITY_backports = "20"
LAYERSERIES_COMPAT_backports = "zeus"

# Let us add layer-specific bbappends which are only applied when that
# layer is included in our configuration
# includes customization and/or backports
BBFILES_DYNAMIC += "${@' '.join('%s:${LAYERDIR}/%s/recipes*/*/*.bbappend' % (layer, layer) \
              for layer in BBFILE_COLLECTIONS.split())}"
# Add layer-specific bb files too
BBFILES_DYNAMIC += "${@' '.join('%s:${LAYERDIR}/%s/recipes*/*/*.bb' % (layer, layer) \
              for layer in BBFILE_COLLECTIONS.split())}"
```

## src/gateway/layers/meta-gateway/conf/layer.conf
```bitbake
# We have a conf and classes directory, add to BBPATH
BBPATH .= ":${LAYERDIR}"

# We have recipes-* directories, add to BBFILES
BBFILES += "${LAYERDIR}/recipes-*/*/*.bb \
            ${LAYERDIR}/recipes-*/*/*.bbappend"

BBFILE_COLLECTIONS += "gateway"
BBFILE_PATTERN_gateway = "^${LAYERDIR}/"
BBFILE_PRIORITY_gateway = "5"
LAYERVERSION_gateway = "4"
LAYERSERIES_COMPAT_gateway = "zeus"
```
